#include "mt7621_zbtlink_zbt-wg827.dtsi"

/ {
	compatible = "zbtlink,zbt-wg827-16m", "zbtlink,zbt-wg827", "mediatek,mt7621-soc";
	model = "Zbtlink ZBT-WG827 (16M)";
};

&firmware {
	reg = <0x50000 0xfb0000>;
};
